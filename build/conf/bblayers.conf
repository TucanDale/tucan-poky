## build/conf/bblayers.conf
```bitbake
# POKY_BBLAYERS_CONF_VERSION is increased each time build/conf/bblayers.conf
# changes incompatibly
POKY_BBLAYERS_CONF_VERSION = "2"

BBPATH = "${TOPDIR}"
BBFILES ?= ""

BBLAYERS ?= " \
  /home/gvaihir/tucanOS_dev/poky/meta \
  /home/gvaihir/tucanOS_dev/poky/meta-poky \
  /home/gvaihir/tucanOS_dev/poky/meta-yocto-bsp \
  /home/gvaihir/tucanOS_dev/meta-tucan-image \
  /home/gvaihir/tucanOS_dev/meta-arm/meta-arm-toolchain \
  /home/gvaihir/tucanOS_dev/meta-arm/meta-arm \
  /home/gvaihir/tucanOS_dev/meta-openembedded/meta-oe \
  /home/gvaihir/tucanOS_dev/meta-openembedded/meta-networking \
  /home/gvaihir/tucanOS_dev/meta-openembedded/meta-multimedia \
  /home/gvaihir/tucanOS_dev/meta-openembedded/meta-python \
  /home/gvaihir/tucanOS_dev/meta-sunxi \
  "
```
